VERSION ""
NS_ :

BS_:
BU_: Node0

BO_ 1 Msg0: 8 Node0
 SG_ Sig0 : 0|8@1+ (1,0) [0|10] "" Node0

EV_ Env0 : 0 [0|1] "" 0 0 DUMMY_NODE_VECTOR0 Node0;

BA_DEF_  "NetAttr" STRING ;
BA_DEF_ BO_  "MsgAttr" HEX 0 255;
BA_DEF_ SG_  "SigAttr" FLOAT 0 100;
BA_DEF_ BU_  "NodeAttr" INT 0 10;
BA_DEF_ EV_  "EnvAttr" INT 0 1;
BA_DEF_DEF_  "NetAttr" "default";
BA_DEF_DEF_ "MsgAttr" 0;
BA_DEF_DEF_ "SigAttr" 0;
BA_DEF_DEF_ "NodeAttr" 0;
BA_DEF_DEF_ "EnvAttr" 0;

BA_ "NetAttr" "net-value";
BA_ "MsgAttr" BO_ 1 10;
BA_ "SigAttr" SG_ 1 Sig0 5.5;
BA_ "NodeAttr" BU_ Node0 7;
BA_ "EnvAttr" EV_ Env0 1;
